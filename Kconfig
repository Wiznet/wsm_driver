## examples/mqtt/main/Kconfig.projbuild
```kconfig
menu "MQTT Example Configuration"

choice EXAMPLE_MQTT_MODE
    prompt "MQTT mode"
    default EXAMPLE_MQTT_PUBLISH_SUBSCRIBE

config EXAMPLE_MQTT_PUBLISH
    bool "Publish only"

config EXAMPLE_MQTT_SUBSCRIBE
    bool "Subscribe only"

config EXAMPLE_MQTT_PUBLISH_SUBSCRIBE
    bool "Publish and subscribe"

endchoice

endmenu
```

## examples/udp/main/Kconfig.projbuild
```kconfig
menu "UDP Example Configuration"

choice EXAMPLE_UDP_ROLE
    prompt "UDP role"
    default EXAMPLE_UDP_SERVER

config EXAMPLE_UDP_SERVER
    bool "UDP server (echo on port 5000)"

config EXAMPLE_UDP_CLIENT
    bool "UDP client (loopback to a peer server)"

endchoice

endmenu
```
